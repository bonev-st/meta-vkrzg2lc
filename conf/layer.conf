## conf/layer.conf
```bitbake
# We have a conf and classes directory, add to BBPATH
BBPATH .= ":${LAYERDIR}"

# We have recipes-* directories, add to BBFILES
BBFILES += "${LAYERDIR}/recipes-*/*/*.bbappend \
            ${LAYERDIR}/recipes-*/*/*/*.bb \
            ${LAYERDIR}/recipes-*/*/*/*.bbappend \
        "

BBFILE_COLLECTIONS += "vkrzg2lc"
BBFILE_PATTERN_vkrzg2lc = "^${LAYERDIR}/"
BBFILE_PRIORITY_vkrzg2lc = "17"

LAYERDEPENDS_vkrzg2lc = "rz-common rzg2l"
LAYERSERIES_COMPAT_vkrzg2lc = "dunfell"

HOSTTOOLS += "xz"
```

## conf/machine/vkrzg2lc.conf
```bitbake
#@TYPE: Machine
#@NAME: Vekatech VKRZG2LC machine
#@DESCRIPTION: RZ/G2LC platform

OVERRIDES_append = ":vkrzg2lc"
SOC_FAMILY = "r9a07g044c"
require conf/machine/include/rzg2l-common.inc
require conf/machine/include/cip-core.inc

DEFAULTTUNE ?= "cortexa55"

TUNE_CONF ?= "conf/machine/include/tune-cortexa55.inc"
require ${TUNE_CONF}

PREFERRED_PROVIDER_virtual/kernel="linux-renesas"

UBOOT_CONFIG ??= "vkrzg2lc"
UBOOT_CONFIG[vkrzg2lc] = "vkrzg2lc_defconfig"

# flash writer
EXTRA_IMAGEDEPENDS += " flash-writer"

# Supported devicetree
KERNEL_DEVICETREE = " renesas/vkrzg2lc.dtb"

KERNEL_DEVICETREE_OVERLAY  = " \
    renesas/overlays/vkrz-audio.dtbo \
    renesas/overlays/vkrz-can.dtbo \
    renesas/overlays/vkrz-cm33.dtbo \
	renesas/overlays/vkrz-csi-imx219.dtbo \
	renesas/overlays/vkrz-dsi-av_disp2.dtbo \
	renesas/overlays/vkrz-dsi-vklcd07.dtbo \
	renesas/overlays/vkrz-dsi-vklcd-ee0700.dtbo \
	renesas/overlays/vkrz-exp-i2c2.dtbo \
	renesas/overlays/vkrz-exp-i2c3.dtbo \
	renesas/overlays/vkrz-exp-pwm0.dtbo \
	renesas/overlays/vkrz-exp-pwm1.dtbo \
	renesas/overlays/vkrz-exp-scfi1.dtbo \
	renesas/overlays/vkrz-exp-scfi1_rst_cts.dtbo \
	renesas/overlays/vkrz-exp-scfi3.dtbo \
	renesas/overlays/vkrz-exp-spi1.dtbo \
	renesas/overlays/vkrz-udma.dtbo \
"

BSP_SOC = "RZG2LC"
BSP_BOARD = "VK-RZ/G2LC-v1.0"

#ENABLE_SPD_OPTEE = '1'
#ENABLE_RZ_SCE    = '1'

IMAGE_BOOT_FILES = " \
	bl2_bp-${MACHINE}.srec \
	fip-${MACHINE}.srec \
	Flash_Writer_SCIF_VKRZG2LC_DDR4_2GB_1PCS.mot \
"
# generate wic image
IMAGE_FSTYPES_append = " wic wic.bz2"
IMAGE_BOOT_FILES += " Image vkrzg2lc.dtb"

# Deploy the uEnv.txt to the /boot directory
WKS_FILE_DEPENDS_append = " uenv"
IMAGE_BOOT_FILES += " uEnv.txt"
IMAGE_BOOT_FILES += " readme.txt"

# Support DTB Overlay files
IMAGE_BOOT_FILES += " overlays/*;overlays/"
#IMAGE_BOOT_FILES += " cm33/*;cm33/"

WKS_FILE = " ${@oe.utils.conditional("CONFIG_WKS_eMMC", "1", " image-vkrzg2lc-mmc0.wks ", " image-vkrzg2lc-sdhi1.wks ", d)} "

# Ship kernel modules
MACHINE_ESSENTIAL_EXTRA_RRECOMMENDS_append = " kernel-modules"

WIC_INPUT_DEPENDS = "firmware-pack:do_deploy flash-writer:do_deploy"
```
